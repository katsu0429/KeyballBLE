## config/west.yml
```yaml
manifest:
  remotes:
    - name: zmkfirmware
      url-base: https://github.com/zmkfirmware
    - name: Dist16384
      url-base: https://github.com/Dist16384
    - name: kot149
      url-base: https://github.com/kot149      


  projects:
    - name: zmk
      remote: zmkfirmware
      revision: main
      import: app/west.yml

    - name: zmk-pmw3610-driver
      remote: Dist16384
      revision: main

    - name: zmk-layout-shift
      remote: kot149
      revision: v1
      path: modules/zmk-layout-shift


  self:
    path: config
```
